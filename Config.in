## configs/annonos_defconfig
```kconfig
# Target Architecture
BR2_x86_64=y
BR2_x86_64_corei7=y

# Kernel Support
BR2_LINUX_KERNEL=y
BR2_LINUX_KERNEL_CUSTOM_VERSION=y
BR2_LINUX_KERNEL_CUSTOM_VERSION_VALUE="6.1.55"
BR2_LINUX_KERNEL_USE_DEFCONFIG=y
BR2_LINUX_KERNEL_DEFCONFIG="x86_64"

# Filesystem & ISO9660 Image Target
BR2_TARGET_ROOTFS_ISO9660=y
BR2_TARGET_ROOTFS_ISO9660_GRUB2=y
BR2_TARGET_ROOTFS_ISO9660_BOOT_MENU="board/annonos-target/grub.cfg"
BR2_TARGET_ROOTFS_ISO9660_HYBRID=y
BR2_TARGET_ROOTFS_ISO9660_INITRD=y

# External Tree Link
BR2_EXTERNAL="../annonos-external"
```

## packages/annonos-core/Config.in
```kconfig
config BR2_PACKAGE_ANNONOS_CORE
	bool "annonos-core"
	depends on BR2_USE_WCHAR
	select BR2_PACKAGE_PYTHON3
	select BR2_PACKAGE_PYTHON_SQLITE
	help
	  AnnonOS sovereign, hardware-rooted, zero-trust core modules,
	  polymorphic security engine, voice auth, mesh sync, and transparency manifests.
```
